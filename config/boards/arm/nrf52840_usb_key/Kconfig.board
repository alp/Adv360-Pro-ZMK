## config/boards/arm/nrf52840_usb_key/Kconfig.board
```kconfig
config BOARD_NRF52840_USB_KEY
    bool "nrf52840_usb_key"
    depends on SOC_NRF52840_QIAA
```

## config/boards/arm/nrf52840_usb_key/Kconfig.defconfig
```kconfig
if BOARD_NRF52840_USB_KEY

config BOARD
    default "nrf52840_usb_key"

config BT_CTLR
    default BT

if USB

config USB_NRFX
    default y

config USB_DEVICE_STACK
    default y

endif # USB

endif # BOARD_NRF52840_USB_KEY
```

## config/boards/shields/dongle/Kconfig.defconfig
```kconfig
if SHIELD_DONGLE

config ZMK_KEYBOARD_NAME
    default "Adv360 Dongle"

config ZMK_SPLIT_BLE_CENTRAL_BATTERY_LEVEL_FETCHING
    default y

config ZMK_USB
    default y

config ZMK_BLE
    default y

endif
```
